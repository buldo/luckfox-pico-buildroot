## configs/luckfox_pico_max_defconfig
```kconfig
BR2_arm=y
BR2_cortex_a7=y

# kernel
BR2_LINUX_KERNEL=y
BR2_LINUX_KERNEL_CUSTOM_TARBALL=y
BR2_LINUX_KERNEL_CUSTOM_TARBALL_LOCATION="https://s3br.bld.zone/pico-kernel-5.10.tar.gz"
BR2_LINUX_KERNEL_DEFCONFIG="luckfox_rv1106_linux"
BR2_LINUX_KERNEL_DTS_SUPPORT=y
BR2_LINUX_KERNEL_INTREE_DTS_NAME="rv1106g-luckfox-pico-max"
BR2_PACKAGE_HOST_LINUX_HEADERS_CUSTOM_5_10=y
BR2_LINUX_KERNEL_NEEDS_HOST_OPENSSL=y
BR2_LINUX_KERNEL_IMAGE_TARGET_CUSTOM=y
BR2_LINUX_KERNEL_IMAGE_NAME="../../../boot.img"
BR2_LINUX_KERNEL_IMAGE_TARGET_NAME="$(BR2_LINUX_KERNEL_INTREE_DTS_NAME).img BOOT_ITS=$(LINUX_DIR)/boot.its"

# u-boot
BR2_PACKAGE_RVBOOT=y
BR2_PACKAGE_RVBOOT_BOARD_DEFCONFIG="luckfox_rv1106_uboot_defconfig"
BR2_PACKAGE_RVBOOT_CONFIG_FRAGMENT_FILE="$(BR2_EXTERNAL_OPENHD_PATH)/board/luckfox/pico/u-boot-sd.config"
BR2_PACKAGE_RVBOOT_CONFIG_FRAGMENT_FILE_NAME="u-boot-sd.config"

BR2_PACKAGE_HOST_UBOOT_TOOLS=y
BR2_PACKAGE_HOST_UBOOT_TOOLS_FIT_SUPPORT=y
BR2_PACKAGE_HOST_UBOOT_TOOLS_ENVIMAGE=y
BR2_PACKAGE_HOST_UBOOT_TOOLS_ENVIMAGE_SOURCE="$(BR2_EXTERNAL_OPENHD_PATH)/board/luckfox/pico/uboot-env.txt"
BR2_PACKAGE_HOST_UBOOT_TOOLS_ENVIMAGE_SIZE="0x200"

# pathes
BR2_GLOBAL_PATCH_DIR="$(BR2_EXTERNAL_OPENHD_PATH)/board/luckfox/pico/patches"

# global options
# todo add C++ 
BR2_OPTIMIZE_2=y


# hello options
BR2_TARGET_GENERIC_HOSTNAME="openhd"
BR2_TARGET_GENERIC_ISSUE="Welcome to openhd"
BR2_TARGET_GENERIC_ROOT_PASSWD="openhd"

# FS
BR2_TARGET_ROOTFS_EXT2=y
BR2_TARGET_ROOTFS_EXT2_4=y
#BR2_TARGET_ROOTFS_EXT2_SIZE="1024M"
BR2_PACKAGE_HOST_GENIMAGE=y
BR2_ROOTFS_POST_IMAGE_SCRIPT="$(BR2_EXTERNAL_OPENHD_PATH)/board/luckfox/pico/post-image.sh"

# packages
BR2_SYSTEM_ENABLE_NLS=y
BR2_PACKAGE_BUSYBOX_SHOW_OTHERS=y
BR2_PACKAGE_E2FSPROGS=y
BR2_PACKAGE_E2FSPROGS_RESIZE2FS=y
BR2_PACKAGE_EVTEST=y
# BR2_PACKAGE_PYTHON3=y
# BR2_PACKAGE_PYTHON3_SSL=y
# BR2_PACKAGE_PYTHON_AIOHTTP=y
# BR2_PACKAGE_PYTHON_CLICK=y
# BR2_PACKAGE_PYTHON_ITSDANGEROUS=y
# BR2_PACKAGE_PYTHON_JINJA2=y
# BR2_PACKAGE_PYTHON_PERIPHERY=y
# BR2_PACKAGE_PYTHON_PILLOW=y
# BR2_PACKAGE_PYTHON_SERIAL=y
# BR2_PACKAGE_PYTHON_SETUPTOOLS=y
# BR2_PACKAGE_PYTHON_SMBUS_CFFI=y
# BR2_PACKAGE_PYTHON_SPIDEV=y
# BR2_PACKAGE_PYTHON_WERKZEUG=y
BR2_PACKAGE_GNUTLS=y
BR2_PACKAGE_LIBMD=y
BR2_PACKAGE_FREETYPE=y
#BR2_PACKAGE_LIBDRM=y
BR2_PACKAGE_DTC=y
BR2_PACKAGE_DTC_PROGRAMS=y
#BR2_PACKAGE_LIBV4L=y
#BR2_PACKAGE_LIBV4L_UTILS=y
BR2_PACKAGE_IPERF=y
BR2_PACKAGE_IPERF3=y
BR2_PACKAGE_LRZSZ=y
BR2_PACKAGE_NTP=y
BR2_PACKAGE_OPENSSH=y
BR2_PACKAGE_SOCAT=y
BR2_PACKAGE_BASH=y
BR2_PACKAGE_BASH_LOADABLE_EXAMPLES=y
BR2_PACKAGE_DIALOG=y
BR2_PACKAGE_TIME=y
BR2_PACKAGE_HTOP=y
BR2_PACKAGE_UTIL_LINUX_LIBMOUNT=y
BR2_PACKAGE_NANO=y
BR2_PACKAGE_HOST_DTC=y
```

## package/rvboot/Config.in
```kconfig
config BR2_PACKAGE_RVBOOT
	bool "rv boot files generation"

config BR2_PACKAGE_RVBOOT_BOARD_DEFCONFIG
	string "Board defconfig"

config BR2_PACKAGE_RVBOOT_CONFIG_FRAGMENT_FILE
	string "Board fragment"

config BR2_PACKAGE_RVBOOT_CONFIG_FRAGMENT_FILE_NAME
	string "Board fragment name"
```
